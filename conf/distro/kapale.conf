## conf/distro/kapale.conf
```bitbake
DISTRO = "Kapule"
DISTRO_NAME = "Kapule Linux"
DISTRO_VERSION = "0.1"
DISTRO_CODENAME = "next"

TARGET_VENDOR = "-kapule"

LOCALCONF_VERSION = "1"
LAYER_CONF_VERSION ?= "6"

SDK_NAME = "${DISTRO}-${TCLIBC}-${SDK_ARCH}-${IMAGE_BASENAME}-${TUNE_PKGARCH}"
SDKPATH = "/opt/${DISTRO}/${SDK_VERSION}"
TCLIBCAPPEND = "" 
```

## conf/layer.conf
```bitbake
# We have a conf and classes directory, add to BBPATH
BBPATH .= ":${LAYERDIR}"

# We have recipes-* directories, add to BBFILES
BBFILES += "${LAYERDIR}/recipes-*/*/*.bb \
	${LAYERDIR}/recipes-*/*/*.bbappend"

BBFILE_COLLECTIONS += "kūpale"
BBFILE_PATTERN_kūpale = "^${LAYERDIR}/"
BBFILE_PRIORITY_kūpale = "6"
```
